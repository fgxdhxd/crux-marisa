## KernelSU/kernel/Kconfig
```kconfig
menu "KernelSU"

config KSU
	tristate "KernelSU function support"
	default y
	help
	  Enable kernel-level root privileges on Android System.
	  To compile as a module, choose M here: the
	  module will be called kernelsu.

# For easier extern ifdef handling
config RKSU
	bool "RKSU compat, do not modify"
	default y

config KSU_DEBUG
	bool "KernelSU debug mode"
	depends on KSU
	default n
	help
	  Enable KernelSU debug mode.

config KSU_ALLOWLIST_WORKAROUND
	bool "KernelSU allowlist workaround"
	depends on KSU
	default n
	help
	  Enable workaround for broken allowlist save

config KPM
	bool "Enable SukiSU KPM"
	depends on KSU && 64BIT
	default n
	help
	  Enabling this option will activate the KPM feature of SukiSU.
	  This option is suitable for scenarios where you need to force KPM to be enabled.
	  but it may affect system stability.
	select KALLSYMS
	select KALLSYMS_ALL

config KSU_MANUAL_HOOK
	bool "KernelSU manual hook mode."
	depends on KSU && KSU != m
	default y if !KPROBES
	default n
	help
	  Enable manual hook support.

config KSU_SHOULD_USE_NEW_TP
	bool "KernelSU tracepoint+kretprobe hook"
	depends on KSU && !KSU_MANUAL_HOOK
	depends on KRETPROBES && KPROBES && HAVE_SYSCALL_TRACEPOINTS
	default y if KPROBES && KRETPROBES && HAVE_SYSCALL_TRACEPOINTS
	default n
	help
	  Enable KPROBES, KRETPROBES and TRACEPOINT hook for KernelSU core.
	  This should not be used on kernel below 5.10.

endmenu
```
